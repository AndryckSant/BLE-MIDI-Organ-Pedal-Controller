/******************************************************************************
 *
 * @file    calibration_service.cpp
 * @author  Andryck Santiago
 * @brief   Pedal calibration service.
 *
 * @details
 * This module implements the calibration logic used by analog inputs.
 *
 * The service observes the input signal and learns the minimum and
 * maximum values reached by the pedal. These limits are then used
 * to normalize the input into a range from 0.0f to 1.0f.
 *
 * The calibration does not depend on the physical ADC voltage range.
 * It learns the actual electrical range generated by the pedal.
 *
 * This module does not access hardware and does not implement
 * application or MIDI logic.
 *
 ******************************************************************************/

#include "calibration_service.h"

namespace
{
//=============================================================================
// Private Constants
//=============================================================================

/**
 * @brief Adaptation rate used when a new calibration extreme is detected.
 *
 * A value of 0.10f means that the newly observed value contributes
 * 10% to the current calibration limit at each update.
 *
 * This provides some filtering against ADC noise while still allowing
 * the calibration range to follow the actual pedal endpoints.
 */
constexpr float kExtremeAdaptationRate = 0.10f;

/**
 * @brief Margin applied around the learned calibration range.
 *
 * The margin prevents small variations around the learned endpoints
 * from immediately forcing the normalized value to exactly 0.0f
 * or 1.0f.
 */
constexpr float kCalibrationMargin = 0.02f;

/**
 * @brief Minimum valid calibration span.
 *
 * Prevents division by an excessively small range when the pedal
 * has not yet been moved sufficiently during calibration.
 */
constexpr float kMinimumCalibrationSpan = 10.0f;

/**
 * @brief Minimum normalized output value.
 */
constexpr float kNormalizedMinimum = 0.0f;

/**
 * @brief Maximum normalized output value.
 */
constexpr float kNormalizedMaximum = 1.0f;

//=============================================================================
// Private Functions
//=============================================================================

/**
 * @brief Clamps a value between a minimum and maximum limit.
 *
 * @param value     Value to clamp.
 * @param minimum   Minimum allowed value.
 * @param maximum   Maximum allowed value.
 *
 * @return Clamped value.
 */
float clamp_value(float value,
                  float minimum,
                  float maximum)
{
    if(value < minimum){
        return minimum;
    }

    if(value > maximum){
        return maximum;
    }

    return value;
}

} // namespace

//=============================================================================
// Public Functions
//=============================================================================

void calibration_init(CalibrationData *calibration)
{
    if(calibration == nullptr){
        return;
    }

    calibration->minimum = 0.0f;
    calibration->maximum = 0.0f;
    calibration->initialized = false;
}

void calibration_update(CalibrationData *calibration,
                        int16_t value)
{
    if(calibration == nullptr){
        return;
    }

    /*
     * The first sample establishes the initial calibration range.
     */
    if(!calibration->initialized){
        calibration->minimum = value;
        calibration->maximum = value;
        calibration->initialized = true;

        return;
    }

    /*
     * A value below the current minimum indicates that the pedal
     * has reached a previously unknown lower endpoint.
     *
     * The adaptation prevents a single noisy sample from
     * immediately defining the complete calibration limit.
     */
    if(value < calibration->minimum){
        calibration->minimum =
            calibration->minimum *
                (1.0f - kExtremeAdaptationRate) +
            static_cast<float>(value) *
                kExtremeAdaptationRate;
    }

    /*
     * A value above the current maximum indicates that the pedal
     * has reached a previously unknown upper endpoint.
     *
     * The same filtering strategy used for the minimum is applied
     * here.
     */
    if(value > calibration->maximum){
        calibration->maximum =
            calibration->maximum *
                (1.0f - kExtremeAdaptationRate) +
            static_cast<float>(value) *
                kExtremeAdaptationRate;
    }
}

void calibration_reset(CalibrationData *calibration)
{
    calibration_init(calibration);
}

float calibration_normalize(const CalibrationData *calibration,
                            int16_t value)
{
    if(calibration == nullptr){
        return kNormalizedMinimum;
    }

    if(!calibration->initialized){
        return kNormalizedMinimum;
    }

    /*
     * Calculate the currently learned calibration span.
     */
    float span =
        calibration->maximum -
        calibration->minimum;

    /*
     * Prevent division by an excessively small calibration range.
     */
    if(span < kMinimumCalibrationSpan){
        span = kMinimumCalibrationSpan;
    }

    /*
     * Extend the learned range slightly on both sides.
     *
     * Example:
     *
     *     minimum                 maximum
     *        |-----------------------|
     *      <-|                       |->
     *       margin                 margin
     *
     * This provides tolerance against small variations in the
     * electrical signal around the learned endpoints.
     */
    float effectiveMinimum =
        calibration->minimum -
        span * kCalibrationMargin;

    float effectiveMaximum =
        calibration->maximum +
        span * kCalibrationMargin;

    /*
     * Prevent an invalid calibration range.
     */
    if(effectiveMaximum <= effectiveMinimum){
        return kNormalizedMinimum;
    }

    /*
     * Convert the ADC value into the normalized range [0.0, 1.0].
     */
    float normalized =
        (static_cast<float>(value) - effectiveMinimum) /
        (effectiveMaximum - effectiveMinimum);

    /*
     * Guarantee that the service never returns a value outside
     * the normalized range.
     */
    return clamp_value(normalized,
                       kNormalizedMinimum,
                       kNormalizedMaximum);
}